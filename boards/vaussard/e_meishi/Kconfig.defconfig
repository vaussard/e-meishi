## boards/vaussard/e_meishi/Kconfig.e_meishi
```kconfig
# SPDX-FileCopyrightText: © 2026 Florian Vaussard
# SPDX-License-Identifier: Apache-2.0

config BOARD_E_MEISHI
	select SOC_STM32U375XX
```

## boards/vaussard/e_meishi/board.yml
```yaml
# SPDX-FileCopyrightText: © 2026 Florian Vaussard
# SPDX-License-Identifier: Apache-2.0

board:
  name: e_meishi
  full_name: Florian's E-Meishi
  vendor: vaussard
  socs:
    - name: stm32u375xx
```

## manifest/west.yml
```yaml
manifest:
  version: "1.2"

  remotes:
    - name: zephyrproject-rtos
      url-base: https://github.com/zephyrproject-rtos

  projects:
    - name: zephyr
      remote: zephyrproject-rtos
      revision: main
      import:
        # Only pull in the HAL and modules that are needed
        name-allowlist:
          - cmsis_6
          - hal_stm32

  self:
    path: manifest
```
